## CMakeLists.txt
```
cmake_minimum_required(VERSION 3.20.0)
find_package(Zephyr REQUIRED HINTS $ENV{ZEPHYR_BASE})

project(nano-drone-quadcopter)

FILE(GLOB app_sources src/*.c)
target_sources(app PRIVATE ${app_sources})
target_include_directories(app PRIVATE includes)
```

## prj.conf
```kconfig
CONFIG_STDOUT_CONSOLE=y
CONFIG_PRINTK=y
CONFIG_PWM=y
CONFIG_LOG=y
CONFIG_LOG_PRINTK=y
CONFIG_LOG_MODE_IMMEDIATE=y
CONFIG_PWM_LOG_LEVEL_DBG=y

#RTT DEBUG
CONFIG_USE_SEGGER_RTT=y
CONFIG_RTT_CONSOLE=n

CONFIG_PWM=y
CONFIG_NRFX_PWM0=y
CONFIG_NRFX_PWM1=y

CONFIG_HEAP_MEM_POOL_SIZE=256

CONFIG_TRACING=y
CONFIG_PERCEPIO_TRACERECORDER=y

# ASSERT
CONFIG_ASSERT=y

# CMSIS-DSP
CONFIG_NEWLIB_LIBC=y
CONFIG_CMSIS_DSP=y

#CONFIG EEPROM
CONFIG_EEPROM=y


# CPU load measure
CONFIG_CPU_LOAD=y
CONFIG_CPU_LOAD_LOG_INTERVAL=2000
CONFIG_CPU_LOAD_LOG_PERIODIC=y

# SYSTEM TRACING
CONFIG_STDOUT_CONSOLE=y
# enable to use thread names
CONFIG_THREAD_NAME=y
CONFIG_SEGGER_SYSTEMVIEW=y
CONFIG_USE_SEGGER_RTT=y
CONFIG_TRACING=y
# enable for post-mortem tracing
CONFIG_SEGGER_SYSVIEW_POST_MORTEM_MODE=n

# CONFIG I2C
CONFIG_I2C=y
CONFIG_I2C_NRFX=y
```

## src/main.c
```c
/*
 * main.c - Containing the main function.
 */

/* Personal configs */

/* Zephyr RTOS includes */
#include <zephyr/kernel.h>
#include <nrfx.h>
#include <zephyr/debug/tracing.h>

/* Project includes */
#include "config.h"
#include "system.h"
#include "led.h"

int main() 
{
  Initialize the platform.
  int err = platformInit();
  if (err != 0) {
    // The firmware is running on the wrong hardware. Halt
    while(1);
  }

  //Launch the system task that will initialize and start everything
  systemLaunch();

  // //TODO: Move to platform launch failed
  ledInit();
  ledSet(0, 1);
  ledSet(1, 1);

  //Should never reach this point!
  while(1);

  return 0;
}
```

## src/app_channel.c
```c
/*
 *    ||          ____  _ __
 * +------+      / __ )(_) /_______________ _____  ___
 * | 0xBC |     / __  / / __/ ___/ ___/ __ `/_  / / _ \
 * +------+    / /_/ / / /_/ /__/ /  / /_/ / / /_/  __/
 *  ||  ||    /_____/_/\__/\___/_/   \__,_/ /___/\___/
 *
 * LPS node firmware.
 *
 * Copyright 2020, Bitcraze AB
 *
 * This program is free software: you can redistribute it and/or modify
 * it under the terms of the GNU Lesser General Public License as published by
 * the Free Software Foundation, either version 3 of the License, or
 * (at your option) any later version.
 *
 * Foobar is distributed in the hope that it will be useful,
 * but WITHOUT ANY WARRANTY; without even the implied warranty of
 * MERCHANTABILITY or FITNESS FOR A PARTICULAR PURPOSE.  See the
 * GNU General Public License for more details.
 *
 * You should have received a copy of the GNU General Public License
 * along with Foobar.  If not, see <http://www.gnu.org/licenses/>.
 */
/* app_channel.c: App realtime communication channel with the ground */

#include "app_channel.h"

#include <string.h>

#include <zephyr/kernel.h>

#include "crtp.h"
#include "platformservice.h"

struct k_mutex sendMutex;

struct k_msgq  rxQueue;
char rxQueueBuffer[10 * sizeof(CRTPPacket)];


static bool overflow;

static int sendDataPacket(void* data, size_t length, const bool doBlock);

// Deprecated
void appchannelSendPacket(void* data, size_t length)
{
  appchannelSendDataPacketBlock(data, length);
}

int appchannelSendDataPacket(void* data, size_t length)
{
  return sendDataPacket(data, length, false);
}

void appchannelSendDataPacketBlock(void* data, size_t length)
{
  sendDataPacket(data, length, true);
}

// Deprecated
size_t appchannelReceivePacket(void* buffer, size_t max_length, int timeout_ms) {
  return appchannelReceiveDataPacket(buffer, max_length, timeout_ms);
}

size_t appchannelReceiveDataPacket(void* buffer, size_t max_length, int timeout_ms) {
  static CRTPPacket packet;
  k_timeout_t tickToWait;
  uint32_t time_ms = timeout_ms;

  if (timeout_ms < 0) {
    tickToWait = K_FOREVER;
  } else {
    tickToWait = k_ms_to_ticks_ceil32(time_ms);
  }

  int result = k_msgq_get(&rxQueue, &packet, K_TICKS(time_ms));

  if (result == 0) {
    int lenghtToCopy = (max_length < packet.size)?max_length:packet.size;
    memcpy(buffer, packet.data, lenghtToCopy);
    return lenghtToCopy;
  } else {
    return 0;
  }
}

bool appchannelHasOverflowOccured()
{
  bool hasOverflowed = overflow;
  overflow = false;

  return hasOverflowed;
}

void appchannelInit()
{
  k_mutex_init(&sendMutex);

  k_msgq_init(&rxQueue, rxQueueBuffer, sizeof(CRTPPacket), 10);

  overflow = false;
}

void appchannelIncomingPacket(CRTPPacket *p)
{
  int res = k_msgq_put(&rxQueue, p, K_NO_WAIT);

  if (res != 0) {
    overflow = true;
  }
}

static int sendDataPacket(void* data, size_t length, const bool doBlock)
{
  static CRTPPacket packet;

  k_mutex_lock(&sendMutex, K_FOREVER);

  packet.size = (length > APPCHANNEL_MTU)?APPCHANNEL_MTU:length;
  memcpy(packet.data, data, packet.size);

  // CRTP channel and ports are set in platformservice
  int result = 0;
  if (doBlock)
  {
    result = platformserviceSendAppchannelPacketBlock(&packet);
  } else {
    result = platformserviceSendAppchannelPacket(&packet);
  }

  k_mutex_unlock(&sendMutex);

  return result;
}
```

## src/comm.c
```c
/*
 *
 * comm.c - High level communication module
 */

#include <stdbool.h>

#include "config.h"

#include "crtp.h"
#include "console.h"
#include "crtpservice.h"
#include "radiolink.h"
#include "usblink.h"
#include "platformservice.h"
#include "syslink.h"
#include "crtp_localization_service.h"

static bool isInit;

void commInit(void)
{
  if (isInit)
    return;

  uartslkInit();
  radiolinkInit();

  /* These functions are moved to be initialized early so
   * that DEBUG_PRINT can be used early */
  // crtpInit();
  // consoleInit();

  crtpSetLink(radiolinkGetLink());

  crtpserviceInit();
  platformserviceInit();
  logInit();
  paramInit();
  locSrvInit();

  //setup CRTP communication channel
  //TODO: check for USB first and prefer USB over radio
  crtpSetLink(radiolinkGetLink());
  
  isInit = true;
}

bool commTest(void)
{
  bool pass=isInit;
  
  pass &= radiolinkTest();
  pass &= crtpTest();
  pass &= crtpserviceTest();
  pass &= platformserviceTest();
  pass &= consoleTest();
  pass &= paramTest();
  
  return pass;
}
```

## src/commander.c
```c
/**
 *    ||          ____  _ __
 * +------+      / __ )(_) /_______________ _____  ___
 * | 0xBC |     / __  / / __/ ___/ ___/ __ `/_  / / _ \
 * +------+    / /_/ / / /_/ /__/ /  / /_/ / / /_/  __/
 *  ||  ||    /_____/_/\__/\___/_/   \__,_/ /___/\___/
 *
 * Crazyflie Firmware
 *
 * Copyright (C) 2011-2012 Bitcraze AB
 *
 * This program is free software: you can redistribute it and/or modify
 * it under the terms of the GNU General Public License as published by
 * the Free Software Foundation, in version 3.
 *
 * This program is distributed in the hope that it will be useful,
 * but WITHOUT ANY WARRANTY; without even the implied warranty of
 * MERCHANTABILITY or FITNESS FOR A PARTICULAR PURPOSE. See the
 * GNU General Public License for more details.
 *
 * You should have received a copy of the GNU General Public License
 * along with this program. If not, see <http://www.gnu.org/licenses/>.
 *
 * commander.c
 */
#include <string.h>
#include "assert.h"

#include "commander.h"
#include "crtp_commander.h"
#include "crtp_commander_high_level.h"

#include "cf_math.h"
#include "param.h"

#include <zephyr\kernel.h>
#include <zephyr\sys\__assert.h>

static bool isInit;
// Static structs are zero-initialized, so nullSetpoint corresponds to
// modeDisable for all stab_mode_t members and zero for all physical values.
// In other words, the controller should cut power upon recieving it.
const static setpoint_t nullSetpoint;
static state_t lastState;
const static int priorityDisable = COMMANDER_PRIORITY_DISABLE;

static uint32_t lastUpdate;
static bool enableHighLevel = false;
const setpoint_t release_setpoint_data;
int release_priority_data;

struct k_msgq setpointQueue;
char __aligned(4) setpointQueueBuffer[1 * sizeof(setpoint_t)];

struct k_msgq priorityQueue;
char __aligned(4) priorityQueueBuffer[1 * sizeof(int)];

/* Public functions */
void commanderInit(void)
{
  k_msgq_init(&setpointQueue, setpointQueueBuffer, sizeof(setpoint_t), 1);
  // __ASSERT(setpointQueue, "commander - set point queue"); // LOOK INTO IT - CAUSING ERROR
  k_msgq_put(&setpointQueue, &nullSetpoint, K_NO_WAIT);

  k_msgq_init(&priorityQueue, priorityQueueBuffer, sizeof(int), 1);
  // __ASSERT(priorityQueue, "commander - priority queue");
  k_msgq_put(&priorityQueue, &priorityDisable, K_NO_WAIT);

  crtpCommanderInit();
  crtpCommanderHighLevelInit();
  lastUpdate = xTaskGetTickCount();

  isInit = true;
}

void commanderSetSetpoint(setpoint_t *setpoint, int priority)
{
  int currentPriority;

  const int peekResult = k_msgq_peek(&priorityQueue, &currentPriority);
  __ASSERT(peekResult == 0, "commander peekresult");

  if (priority >= currentPriority) {
    setpoint->timestamp = k_uptime_ticks();
    // This is a potential race but without effect on functionality
    k_msgq_get(&setpointQueue, &release_setpoint_data, K_NO_WAIT);
    k_msgq_put(&setpointQueue, setpoint, K_NO_WAIT);

    k_msgq_get(&priorityQueue, &release_priority_data, K_NO_WAIT);
    k_msgq_put(&priorityQueue, &priority, K_NO_WAIT);

    if (priority > COMMANDER_PRIORITY_HIGHLEVEL) {
      // Disable the high-level planner so it will forget its current state and
      // start over if we switch from low-level to high-level in the future.
      crtpCommanderHighLevelDisable();
    }
  }
}

void commanderRelaxPriority()
{
  crtpCommanderHighLevelTellState(&lastState);
  int priority = COMMANDER_PRIORITY_LOWEST;
  k_msgq_get(&priorityQueue, &release_priority_data, K_NO_WAIT);
  k_msgq_put(&priorityQueue, &priority, K_NO_WAIT);
}

void commanderGetSetpoint(setpoint_t *setpoint, const state_t *state)
{
  k_msgq_peek(&setpointQueue, setpoint);
  lastUpdate = setpoint->timestamp;
  uint32_t currentTime = xTaskGetTickCount();

  if ((currentTime - setpoint->timestamp) > COMMANDER_WDT_TIMEOUT_SHUTDOWN) {
    memcpy(setpoint, &nullSetpoint, sizeof(nullSetpoint));
  } else if ((currentTime - setpoint->timestamp) > COMMANDER_WDT_TIMEOUT_STABILIZE) {
    k_msgq_get(&priorityQueue, &release_priority_data, K_NO_WAIT);
    k_msgq_put(&priorityQueue, &priorityDisable, K_NO_WAIT);
    // Leveling ...
    setpoint->mode.x = modeDisable;
    setpoint->mode.y = modeDisable;
    setpoint->mode.roll = modeAbs;
    setpoint->mode.pitch = modeAbs;
    setpoint->mode.yaw = modeVelocity;
    setpoint->attitude.roll = 0;
    setpoint->attitude.pitch = 0;
    setpoint->attitudeRate.yaw = 0;
    // Keep Z as it is
  }
  // This copying is not strictly necessary because stabilizer.c already keeps
  // a static state_t containing the most recent state estimate. However, it is
  // not accessible by the public interface.
  lastState = *state;
}

bool commanderTest(void)
{
  return isInit;
}

uint32_t commanderGetInactivityTime(void)
{
  return k_uptime_ticks() - lastUpdate;
}

int commanderGetActivePriority(void)
{
  int priority;

  const int peekResult = k_msgq_peek(&priorityQueue, &priority);
  __ASSERT(peekResult == 0, "commander peek result == 0");

  return priority;
}

/**
 *
 * The high level commander handles the setpoints from within the firmware
 * based on a predefined trajectory. This was merged as part of the
 * [Crazyswarm](%https://crazyswarm.readthedocs.io/en/latest/) project of the
 * [USC ACT lab](%https://act.usc.edu/) (see this
 * [blogpost](%https://www.bitcraze.io/2018/02/merging-crazyswarm-functionality-into-the-official-crazyflie-firmware/)).
 * The high-level commander uses a planner to generate smooth trajectories
 * based on actions like ‘take off’, ‘go to’ or ‘land’ with 7th order
 * polynomials. The planner generates a group of setpoints, which will be
 * handled by the High level commander and send one by one to the commander
 * framework.
 *
 * It is also possible to upload your own custom trajectory to the memory of
 * the Crazyflie, which you can try out with the script
 * `examples/autonomous_sequence_high_level of.py` in the Crazyflie python
 * library repository.
 */
PARAM_GROUP_START(commander)

/**
 *  @brief Enable high level commander
 */
PARAM_ADD_CORE(PARAM_UINT8, enHighLevel, &enableHighLevel)

PARAM_GROUP_STOP(commander)
```

## src/configblockeeprom.c
```c
/**
 * configblock.c - Simple static implementation of the config block
 */
#define DEBUG_MODULE "CFGBLK"

#include <zephyr\logging\log.h>

#include <stdint.h>
#include <stdbool.h>
#include <unistd.h>
#include <string.h>

#include "config.h"
#include "configblock.h"
#include "eeprom.h"

LOG_MODULE_REGISTER(config_eeprom_block);


/* Internal format of the config block */
#define MAGIC 0x43427830
#define VERSION 1
#define HEADER_SIZE_BYTES 5 // magic + version
#define OVERHEAD_SIZE_BYTES (HEADER_SIZE_BYTES + 1) // + cksum

// Old versions
struct configblock_v0_s {
  /* header */
  uint32_t magic;
  uint8_t  version;
  /* Content */
  uint8_t radioChannel;
  uint8_t radioSpeed;
  float calibPitch;
  float calibRoll;
  /* Simple modulo 256 checksum */
  uint8_t cksum;
} __attribute__((__packed__));

// Current version
struct configblock_v1_s {
  /* header */
  uint32_t magic;
  uint8_t  version;
  /* Content */
  uint8_t radioChannel;
  uint8_t radioSpeed;
  float calibPitch;
  float calibRoll;
  uint8_t radioAddress_upper;
  uint32_t radioAddress_lower;
  /* Simple modulo 256 checksum */
  uint8_t cksum;
} __attribute__((__packed__));

// Set version 1 as current version
typedef struct configblock_v1_s configblock_t;

static configblock_t configblock;
static configblock_t configblockDefault =
{
    .magic = MAGIC,
    .version = VERSION,
    .radioChannel = RADIO_CHANNEL,
    .radioSpeed = RADIO_DATARATE,
    .calibPitch = 0.0,
    .calibRoll = 0.0,
    .radioAddress_upper = ((uint64_t)RADIO_ADDRESS >> 32),
    .radioAddress_lower = (RADIO_ADDRESS & 0xFFFFFFFFULL),
};

static const uint32_t configblockSizes[] =
{
  sizeof(struct configblock_v0_s),
  sizeof(struct configblock_v1_s),
};

static bool isInit = false;
static bool cb_ok = false;

static bool configblockCheckMagic(configblock_t *configblock);
static bool configblockCheckVersion(configblock_t *configblock);
static bool configblockCheckChecksum(configblock_t *configblock);
static bool configblockCheckDataIntegrity(uint8_t *data, uint8_t version);
static bool configblockWrite(configblock_t *configblock);
static bool configblockCopyToNewVersion(configblock_t *configblockSaved, configblock_t *configblockNew);

static uint8_t calculate_cksum(void* data, size_t len)
{
  unsigned char* c = data;
  int i;
  unsigned char cksum=0;
  
  for (i=0; i<len; i++)
    cksum += *(c++);

  return cksum;
}

int configblockInit(void)
{
  if(isInit)
    return 0;

  eepromInit(I2C1_DEV);

  // Because of strange behavior from I2C device during expansion port test
  // the first read needs to be discarded
  eepromTestConnection();

  if (eepromTestConnection())
  {
    if (eepromReadBuffer((uint8_t *)&configblock, 0, sizeof(configblock)))
    {
      //Verify the config block
      if (configblockCheckMagic(&configblock))
      {
        if (configblockCheckVersion(&configblock))
        {
          if (configblockCheckChecksum(&configblock))
          {
            // Everything is fine
            LOG_INF("v%d, verification [OK]\n", configblock.version);
            cb_ok = true;
          }
          else
          {
            LOG_INF("Verification [FAIL]\n");
            cb_ok = false;
          }
        }
        else // configblockCheckVersion
        {
          // Check data integrity of old version data
          if (configblock.version <= VERSION &&
              configblockCheckDataIntegrity((uint8_t *)&configblock, configblock.version))
          {
            // Not the same version, try to upgrade
            if (configblockCopyToNewVersion(&configblock, &configblockDefault))
            {
              // Write updated config block to eeprom
              if (configblockWrite(&configblock))
              {
                cb_ok = true;
              }
            }
          }
          else
          {
            // Can't copy old version due to bad data.
            cb_ok = false;
          }
        }
      }
    }
  }

  if (cb_ok == false)
  {
    // Copy default data to used structure.
    memcpy((uint8_t *)&configblock, (uint8_t *)&configblockDefault, sizeof(configblock));
    // Write default configuration to eeprom
    if (configblockWrite(&configblockDefault))
    {
      cb_ok = true;
    }
    else
    {
      return -1;
    }
  }

  isInit = true;

  return 0;
}

bool configblockTest(void)
{
  return eepromTest();
}

static bool configblockCheckMagic(configblock_t *configblock)
{
  return (configblock->magic == MAGIC);
}

static bool configblockCheckVersion(configblock_t *configblock)
{
  return (configblock->version == VERSION);
}

static bool configblockCheckChecksum(configblock_t *configblock)
{
  return (configblock->cksum == calculate_cksum(configblock, sizeof(configblock_t) - 1));
}

static bool configblockCheckDataIntegrity(uint8_t *data, uint8_t version)
{
  bool status = false;

  if (version == 0)
  {
    struct configblock_v0_s *v0 = ( struct configblock_v0_s *)data;
    status = (v0->cksum == calculate_cksum(data, sizeof(struct configblock_v0_s) - 1));
  }
  else if (version == 1)
  {
    struct configblock_v1_s *v1 = ( struct configblock_v1_s *)data;
    status = (v1->cksum == calculate_cksum(data, sizeof(struct configblock_v1_s) - 1));
  }

  return status;
}

static bool configblockWrite(configblock_t *configblock)
{
  // Write default configuration to eeprom
  configblock->cksum = calculate_cksum(configblock, sizeof(configblock_t) - 1);
  if (!eepromWriteBuffer((uint8_t *)configblock, 0, sizeof(configblock_t)))
  {
    return false;
  }

  return true;
}

static bool configblockCopyToNewVersion(configblock_t *configblockSaved, configblock_t *configblockNew)
{
  configblock_t configblockTmp;

  // Copy new data to temp config memory
  memcpy((uint8_t *)&configblockTmp, (uint8_t *)configblockNew, sizeof(configblock_t));

  if (configblockSaved->version <= VERSION &&
      sizeof(configblock_t) >= configblockSizes[configblockSaved->version])
  {
    // Copy old saved eeprom data to new structure
    memcpy((uint8_t *)&configblockTmp + HEADER_SIZE_BYTES,
           (uint8_t *)configblockSaved + HEADER_SIZE_BYTES,
           configblockSizes[configblockSaved->version] - OVERHEAD_SIZE_BYTES);
    // Copy updated block to saved structure
    memcpy((uint8_t *)configblockSaved, (uint8_t *)&configblockTmp, sizeof(configblock_t));
  }
  else
  {
    return false;
  }

  return true;
}

/* Static accessors */
int configblockGetRadioChannel(void)
{
  if (cb_ok)
    return configblock.radioChannel;
  else
    return RADIO_CHANNEL;
}

int configblockGetRadioSpeed(void)
{
  if (cb_ok)
    return configblock.radioSpeed;
  else
    return RADIO_DATARATE;
}

uint64_t configblockGetRadioAddress(void)
{
  if (cb_ok)
    return ((uint64_t)configblock.radioAddress_upper << 32) | (uint64_t)configblock.radioAddress_lower;
  else
    return RADIO_ADDRESS;
}

float configblockGetCalibPitch(void)
{
  if (cb_ok)
    return configblock.calibPitch;
  else
    return 0;
}

float configblockGetCalibRoll(void)
{
  if (cb_ok)
    return configblock.calibRoll;
  else
    return 0;
}
```

## src/console.c
```c
/**
 * console.c - Used to send console data to client
 */

#include <string.h>

/* ZEPHYR RTOS includes*/
#include <zephyr/kernel.h>
#include "console.h"

#include "crtp.h"

static CRTPPacket messageToPrint;
static bool messageSendingIsPending = false;
struct k_sem synch;


static const char bufferFullMsg[] = "<F>\n";
static bool isInit;

static void addBufferFullMarker();


/**
 * Send the data to the client
 * returns TRUE if successful otherwise FALSE
 */
static bool consoleSendMessage(void)
{
  if (crtpSendPacket(&messageToPrint) == 0)
  {
    messageToPrint.size = 0;
    messageSendingIsPending = false;
  }
  else
  {
    return false;
  }

  return true;
}

void consoleInit()
{
  if (isInit)
    return;

  messageToPrint.size = 0;
  messageToPrint.header = CRTP_HEADER(CRTP_PORT_CONSOLE, 0);
  k_sem_init(&synch, 0, 1);
  messageSendingIsPending = false;

  isInit = true;
}

bool consoleTest(void)
{
  return isInit;
}

int consolePutchar(int ch)
{
  bool isInInterrupt = (SCB->ICSR & SCB_ICSR_VECTACTIVE_Msk) != 0;

  if (!isInit) {
    return 0;
  }

  if (isInInterrupt) {
    return consolePutcharFromISR(ch);
  }

  if (k_sem_take(&synch, K_FOREVER) == 0)
  {
    // Try to send if we already have a pending message
    if (messageSendingIsPending)
    {
      consoleSendMessage();
    }

    if (! messageSendingIsPending)
    {
      if (messageToPrint.size < CRTP_MAX_DATA_SIZE)
      {
        messageToPrint.data[messageToPrint.size] = (unsigned char)ch;
        messageToPrint.size++;
      }

      if (ch == '\n' || messageToPrint.size >= CRTP_MAX_DATA_SIZE)
      {
        if (crtpGetFreeTxQueuePackets() == 1)
        {
          addBufferFullMarker();
        }
        messageSendingIsPending = true;
        consoleSendMessage();
      }
    }
    k_sem_give(&synch);
  }

  return (unsigned char)ch;
}

int consolePutcharFromISR(int ch) {
  // BaseType_t higherPriorityTaskWoken;

  if (k_sem_take(&synch, K_NO_WAIT) == 0) {
    if (messageToPrint.size < CRTP_MAX_DATA_SIZE)
    {
      messageToPrint.data[messageToPrint.size] = (unsigned char)ch;
      messageToPrint.size++;
    }
    k_sem_give(&synch);
  }

  return ch;
}

int consolePuts(const char *str)
{
  int ret = 0;

  while(*str)
    ret |= consolePutchar(*str++);

  return ret;
}

void consoleFlush(void)
{
  if (k_sem_take(&synch, K_FOREVER) == 0)
  {
    consoleSendMessage();
    k_sem_give(&synch);
  }
}


static int findMarkerStart()
{
  int start = messageToPrint.size;

  // If last char is new line, rewind one char since the marker contains a new line.
  if (start > 0 && messageToPrint.data[start - 1] == '\n')
  {
    start -= 1;
  }

  return start;
}

static void addBufferFullMarker()
{
  // Try to add the marker after the message if it fits in the buffer, otherwise overwrite the end of the message
  int endMarker = findMarkerStart() + sizeof(bufferFullMsg);
  if (endMarker >= (CRTP_MAX_DATA_SIZE))
  {
    endMarker = CRTP_MAX_DATA_SIZE;
  }

  int startMarker = endMarker - sizeof(bufferFullMsg);
  memcpy(&messageToPrint.data[startMarker], bufferFullMsg, sizeof(bufferFullMsg));
  messageToPrint.size = startMarker + sizeof(bufferFullMsg);
}
```

## src/controller.c
```c
#define DEBUG_MODULE "CONTROLLER"
// #include "debug.h"

#include "cfassert.h"
#include "controller.h"
#include "controller_pid.h"
/* For future update */
// #include "controller_mellinger.h"
// #include "controller_indi.h"
// #include "controller_brescianini.h"

#include "autoconf.h"

#define DEFAULT_CONTROLLER ControllerTypePID
static ControllerType currentController = ControllerTypeAutoSelect;

static void initController();

typedef struct {
  void (*init)(void);
  bool (*test)(void);
  void (*update)(control_t *control, const setpoint_t *setpoint, const sensorData_t *sensors, const state_t *state, const uint32_t tick);
  const char* name;
} ControllerFcns;

static ControllerFcns controllerFunctions[] = {
  {.init = 0, .test = 0, .update = 0, .name = "None"}, // Any
  {.init = controllerPidInit, .test = controllerPidTest, .update = controllerPid, .name = "PID"},
  // {.init = controllerMellingerFirmwareInit, .test = controllerMellingerFirmwareTest, .update = controllerMellingerFirmware, .name = "Mellinger"},
  // {.init = controllerINDIInit, .test = controllerINDITest, .update = controllerINDI, .name = "INDI"},
  // {.init = controllerBrescianiniInit, .test = controllerBrescianiniTest, .update = controllerBrescianini, .name = "Brescianini"},
  #ifdef CONFIG_CONTROLLER_OOT
  {.init = controllerOutOfTreeInit, .test = controllerOutOfTreeTest, .update = controllerOutOfTree, .name = "OutOfTree"},
  #endif
};


void controllerInit(ControllerType controller) {
  if (controller < 0 || controller >= ControllerType_COUNT) {
    return;
  }

  currentController = controller;

  if (ControllerTypeAutoSelect == currentController) {
    currentController = DEFAULT_CONTROLLER;
  }

  #if defined(CONFIG_CONTROLLER_PID)
    #define CONTROLLER ControllerTypePID
  #elif defined(CONFIG_CONTROLLER_INDI)
    #define CONTROLLER ControllerTypeINDI
  #elif defined(CONFIG_CONTROLLER_MELLINGER)
    #define CONTROLLER ControllerTypeMellinger
  #elif defined(CONFIG_CONTROLLER_BRESCIANINI)
    #define CONTROLLER ControllerTypeBrescianini
  #else
    #define CONTROLLER ControllerTypeAutoSelect
  #endif

  ControllerType forcedController = CONTROLLER;
  if (forcedController != ControllerTypeAutoSelect) {
    printk("Controller type forced\n");
    currentController = forcedController;
  }

  initController();

  printk("Using %s (%d) controller\n", controllerGetName(), currentController);
}

ControllerType controllerGetType(void) {
  return currentController;
}

static void initController() {
  controllerFunctions[currentController].init();
}

bool controllerTest(void) {
  return controllerFunctions[currentController].test();
}

void controller(control_t *control, const setpoint_t *setpoint, const sensorData_t *sensors, const state_t *state, const uint32_t tick) {
  controllerFunctions[currentController].update(control, setpoint, sensors, state, tick);
}

const char* controllerGetName() {
  return controllerFunctions[currentController].name;
}
```

## src/controller_pid.c
```c
#include "stabilizer_types.h"

#include "attitude_controller.h"
#include "position_controller.h"
#include "controller_pid.h"

#include "param.h"
#include "math3d.h"

#define ATTITUDE_UPDATE_DT    (float)(1.0f/ATTITUDE_RATE)

static attitude_t attitudeDesired;
static attitude_t rateDesired;
static float actuatorThrust;

static float cmd_thrust;
static float cmd_roll;
static float cmd_pitch;
static float cmd_yaw;
static float r_roll;
static float r_pitch;
static float r_yaw;
static float accelz;

void controllerPidInit(void)
{
  attitudeControllerInit(ATTITUDE_UPDATE_DT);
  positionControllerInit();
}

bool controllerPidTest(void)
{
  bool pass = true;

  pass &= attitudeControllerTest();

  return pass;
}

static float capAngle(float angle) {
  float result = angle;

  while (result > 180.0f) {
    result -= 360.0f;
  }

  while (result < -180.0f) {
    result += 360.0f;
  }

  return result;
}

void controllerPid(control_t *control, const setpoint_t *setpoint,
                                         const sensorData_t *sensors,
                                         const state_t *state,
                                         const uint32_t tick)
{
  control->controlMode = controlModeLegacy;

  if (RATE_DO_EXECUTE(ATTITUDE_RATE, tick)) {
    // Rate-controled YAW is moving YAW angle setpoint
    if (setpoint->mode.yaw == modeVelocity) {
      attitudeDesired.yaw = capAngle(attitudeDesired.yaw + setpoint->attitudeRate.yaw * ATTITUDE_UPDATE_DT);

      float yawMaxDelta = attitudeControllerGetYawMaxDelta();
      if (yawMaxDelta != 0.0f)
      {
      float delta = capAngle(attitudeDesired.yaw-state->attitude.yaw);
      // keep the yaw setpoint within +/- yawMaxDelta from the current yaw
        if (delta > yawMaxDelta)
        {
          attitudeDesired.yaw = state->attitude.yaw + yawMaxDelta;
        }
        else if (delta < -yawMaxDelta)
        {
          attitudeDesired.yaw = state->attitude.yaw - yawMaxDelta;
        }
      }
    } else if (setpoint->mode.yaw == modeAbs) {
      attitudeDesired.yaw = setpoint->attitude.yaw;
    } else if (setpoint->mode.quat == modeAbs) {
      struct quat setpoint_quat = mkquat(setpoint->attitudeQuaternion.x, setpoint->attitudeQuaternion.y, setpoint->attitudeQuaternion.z, setpoint->attitudeQuaternion.w);
      struct vec rpy = quat2rpy(setpoint_quat);
      attitudeDesired.yaw = degrees(rpy.z);
    }

    attitudeDesired.yaw = capAngle(attitudeDesired.yaw);
  }

  if (RATE_DO_EXECUTE(POSITION_RATE, tick)) {
    positionController(&actuatorThrust, &attitudeDesired, setpoint, state);
  }

  if (RATE_DO_EXECUTE(ATTITUDE_RATE, tick)) {
    // Switch between manual and automatic position control
    if (setpoint->mode.z == modeDisable) {
      actuatorThrust = setpoint->thrust;
    }
    if (setpoint->mode.x == modeDisable || setpoint->mode.y == modeDisable) {
      attitudeDesired.roll = setpoint->attitude.roll;
      attitudeDesired.pitch = setpoint->attitude.pitch;
    }

    attitudeControllerCorrectAttitudePID(state->attitude.roll, state->attitude.pitch, state->attitude.yaw,
                                attitudeDesired.roll, attitudeDesired.pitch, attitudeDesired.yaw,
                                &rateDesired.roll, &rateDesired.pitch, &rateDesired.yaw);

    // For roll and pitch, if velocity mode, overwrite rateDesired with the setpoint
    // value. Also reset the PID to avoid error buildup, which can lead to unstable
    // behavior if level mode is engaged later
    if (setpoint->mode.roll == modeVelocity) {
      rateDesired.roll = setpoint->attitudeRate.roll;
      attitudeControllerResetRollAttitudePID();
    }
    if (setpoint->mode.pitch == modeVelocity) {
      rateDesired.pitch = setpoint->attitudeRate.pitch;
      attitudeControllerResetPitchAttitudePID();
    }

    // TODO: Investigate possibility to subtract gyro drift.
    attitudeControllerCorrectRatePID(sensors->gyro.x, -sensors->gyro.y, sensors->gyro.z,
                             rateDesired.roll, rateDesired.pitch, rateDesired.yaw);

    attitudeControllerGetActuatorOutput(&control->roll,
                                        &control->pitch,
                                        &control->yaw);

    control->yaw = -control->yaw;

    cmd_thrust = control->thrust;
    cmd_roll = control->roll;
    cmd_pitch = control->pitch;
    cmd_yaw = control->yaw;
    r_roll = radians(sensors->gyro.x);
    r_pitch = -radians(sensors->gyro.y);
    r_yaw = radians(sensors->gyro.z);
    accelz = sensors->acc.z;
  }

  control->thrust = actuatorThrust;

  if (control->thrust == 0)
  {
    control->thrust = 0;
    control->roll = 0;
    control->pitch = 0;
    control->yaw = 0;

    cmd_thrust = control->thrust;
    cmd_roll = control->roll;
    cmd_pitch = control->pitch;
    cmd_yaw = control->yaw;

    attitudeControllerResetAllPID();
    positionControllerResetAllPID();

    // Reset the calculated YAW angle for rate control
    attitudeDesired.yaw = state->attitude.yaw;
  }
}

/**
 * Logging variables for the command and reference signals for the
 * altitude PID controller
 */
// LOG_GROUP_START(controller)
// /**
//  * @brief Thrust command
//  */
// LOG_ADD(LOG_FLOAT, cmd_thrust, &cmd_thrust)
// /**
//  * @brief Roll command
//  */
// LOG_ADD(LOG_FLOAT, cmd_roll, &cmd_roll)
// /**
//  * @brief Pitch command
//  */
// LOG_ADD(LOG_FLOAT, cmd_pitch, &cmd_pitch)
// /**
//  * @brief yaw command
//  */
// LOG_ADD(LOG_FLOAT, cmd_yaw, &cmd_yaw)
// /**
//  * @brief Gyro roll measurement in radians
//  */
// LOG_ADD(LOG_FLOAT, r_roll, &r_roll)
// /**
//  * @brief Gyro pitch measurement in radians
//  */
// LOG_ADD(LOG_FLOAT, r_pitch, &r_pitch)
// /**
//  * @brief Yaw  measurement in radians
//  */
// LOG_ADD(LOG_FLOAT, r_yaw, &r_yaw)
// /**
//  * @brief Acceleration in the zaxis in G-force
//  */
// LOG_ADD(LOG_FLOAT, accelz, &accelz)
// /**
//  * @brief Thrust command without (tilt)compensation
//  */
// LOG_ADD(LOG_FLOAT, actuatorThrust, &actuatorThrust)
// /**
//  * @brief Desired roll setpoint
//  */
// LOG_ADD(LOG_FLOAT, roll,      &attitudeDesired.roll)
// /**
//  * @brief Desired pitch setpoint
//  */
// LOG_ADD(LOG_FLOAT, pitch,     &attitudeDesired.pitch)
// /**
//  * @brief Desired yaw setpoint
//  */
// LOG_ADD(LOG_FLOAT, yaw,       &attitudeDesired.yaw)
// /**
//  * @brief Desired roll rate setpoint
//  */
// LOG_ADD(LOG_FLOAT, rollRate,  &rateDesired.roll)
// /**
//  * @brief Desired pitch rate setpoint
//  */
// LOG_ADD(LOG_FLOAT, pitchRate, &rateDesired.pitch)
// /**
//  * @brief Desired yaw rate setpoint
//  */
// LOG_ADD(LOG_FLOAT, yawRate,   &rateDesired.yaw)
// LOG_GROUP_STOP(controller)
```

## src/crtp.c
```c
/**
 * crtp.c - CrazyRealtimeTransferProtocol stack
 */

#include <stdbool.h>
#include <errno.h>

/*ZEPHYR RTOS includes*/

#include <zephyr/kernel.h>
#include <zephyr/logging/log.h>

#include "config.h"

#include "crtp.h"
#include "info.h"
#include "cfassert.h"
// #include "queuemonitor.h"
// #include "static_mem.h"


static bool isInit;

static int nopFunc(void);
static struct crtpLinkOperations nopLink = {
  .setEnable         = (void*) nopFunc,
  .sendPacket        = (void*) nopFunc,
  .receivePacket     = (void*) nopFunc,
};

static struct crtpLinkOperations *link = &nopLink;

#define STATS_INTERVAL 500
static struct {
  uint32_t rxCount;
  uint32_t txCount;

  uint16_t rxRate;
  uint16_t txRate;

  uint32_t nextStatisticsTime;
  uint32_t previousStatisticsTime;
} stats;

#define CRTP_NBR_OF_PORTS 16
#define CRTP_TX_QUEUE_SIZE 120
#define CRTP_RX_QUEUE_SIZE 16

/* MESSAGE QUEUE */
struct k_msgq txQueue;
K_MSGQ_DEFINE(txQueue, sizeof(CRTPPacket), CRTP_TX_QUEUE_SIZE, 4);

struct k_msgq queues[CRTP_NBR_OF_PORTS];
char __aligned(4) queue_msgq_buffer[CRTP_RX_QUEUE_SIZE * sizeof(CRTPPacket)];


static volatile CrtpCallback callbacks[CRTP_NBR_OF_PORTS];
static void updateStats();


extern void crtpTxTask(void *, void *, void *);
extern void crtpRxTask(void *, void *, void *);

/* THREAD DEFINE */
struct k_thread crtpTxTaskThread;
struct k_thread crtpRxTaskThread;

/* THREAD STATCK MEM DEFINE*/
K_THREAD_STACK_DEFINE(crtpTxTaskStack, CRTP_TX_TASK_STACKSIZE);
K_THREAD_STACK_DEFINE(crtpRxTaskStack, CRTP_RX_TASK_STACKSIZE);

void crtpInit(void)
{
  if(isInit)
    return;

  // DEBUG_QUEUE_MONITOR_REGISTER(txQueue); ------------look into it

  k_thread_create(&crtpTxTaskThread, 
                  crtpTxTaskStack, 
                  K_THREAD_STACK_SIZEOF(crtpTxTaskStack), 
                  crtpTxTask, 
                  NULL, NULL, NULL, 
                  CRTP_TX_TASK_PRI, 0, K_NO_WAIT);
  k_thread_create(&crtpRxTaskThread, 
                  crtpRxTaskStack, 
                  K_THREAD_STACK_SIZEOF(crtpRxTaskStack), 
                  crtpRxTask, 
                  NULL, NULL, NULL, 
                  CRTP_RX_TASK_PRI, 0, K_NO_WAIT);

  isInit = true;
}

bool crtpTest(void)
{
  return isInit;
}

void crtpInitTaskQueue(CRTPPort portId)
{
  // __ASSERT(queues[portId] == NULL, "queues"); (look into these type - causing error)

  k_msgq_init(&queues[portId], queue_msgq_buffer, sizeof(CRTPPacket), CRTP_RX_QUEUE_SIZE);

}

int crtpReceivePacket(CRTPPort portId, CRTPPacket *p)
{
  // __ASSERT(queues[portId], "queues");
  __ASSERT(p, "p data");

  return k_msgq_get(&queues[portId], p, K_NO_WAIT);
}

int crtpReceivePacketBlock(CRTPPort portId, CRTPPacket *p)
{
  // __ASSERT(queues[portId], "queues");
  __ASSERT(p, "p data");

  return k_msgq_get(&queues[portId], p, K_FOREVER);
}


int crtpReceivePacketWait(CRTPPort portId, CRTPPacket *p, int wait)
{
  // __ASSERT(queues[portId], "queues");
  __ASSERT(p, "p data");

  return k_msgq_get(&queues[portId], p, K_MSEC(wait));
}

int crtpGetFreeTxQueuePackets(void)
{
  return (CRTP_TX_QUEUE_SIZE - k_msgq_num_used_get(&txQueue));
}

void crtpTxTask(void *, void *, void *)
{
  CRTPPacket p;

  while (true)
  {
    if (link != &nopLink)
    {
      if (k_msgq_get(&txQueue, &p, K_FOREVER) == 0)
      {
        // Keep testing, if the link changes to USB it will go though
        while (link->sendPacket(&p) == false)
        {
          // Relaxation time
          k_sleep(K_MSEC(10));
        }
        stats.txCount++;
        updateStats();
      }
    }
    else
    {
      k_sleep(K_MSEC(10));
    }
  }
}

void crtpRxTask(void *, void *, void *)
{
  CRTPPacket p;

  while (true)
  {
    if (link != &nopLink)
    {
      if (!link->receivePacket(&p))
      {
        if (queues[p.port].used_msgs == CRTP_RX_QUEUE_SIZE)
        {
          // Block, since we should never drop a packet
          k_msgq_put(&queues[p.port], &p, K_FOREVER);
        }

        if (callbacks[p.port])
        {
          callbacks[p.port](&p);
        }

        stats.rxCount++;
        updateStats();
      }
    }
    else
    {
      k_sleep(K_MSEC(10));
    }
  }
}

void crtpRegisterPortCB(int port, CrtpCallback cb)
{
  if (port>CRTP_NBR_OF_PORTS)
    return;

  callbacks[port] = cb;
}

int crtpSendPacket(CRTPPacket *p)
{
  __ASSERT(p, "p data");
  __ASSERT(p->size <= CRTP_MAX_DATA_SIZE, "p data check");

  return k_msgq_put(&txQueue, p, K_NO_WAIT);
}

int crtpSendPacketBlock(CRTPPacket *p)
{
  __ASSERT(p, "p data");
  __ASSERT(p->size <= CRTP_MAX_DATA_SIZE, "p data check");

  return k_msgq_put(&txQueue, p, K_FOREVER);
}

int crtpReset(void)
{
  k_msgq_purge(&txQueue);
  if (link->reset) {
    link->reset();
  }

  return 0;
}

bool crtpIsConnected(void)
{
  if (link->isConnected)
    return link->isConnected();
  return true;
}

void crtpSetLink(struct crtpLinkOperations * lk)
{
  if(link)
    link->setEnable(false);

  if (lk)
    link = lk;
  else
    link = &nopLink;

  link->setEnable(true);
}

static int nopFunc(void)
{
  return ENETDOWN;
}

static void clearStats()
{
  stats.rxCount = 0;
  stats.txCount = 0;
}

static void updateStats()
{
  uint32_t now = (uint32_t)k_uptime_get();
  if (now > stats.nextStatisticsTime) {
    float interval = now - stats.previousStatisticsTime;
    stats.rxRate = (uint16_t)(1000.0f * stats.rxCount / interval);
    stats.txRate = (uint16_t)(1000.0f * stats.txCount / interval);

    clearStats();
    stats.previousStatisticsTime = now;
    stats.nextStatisticsTime = now + STATS_INTERVAL;
  }
}

// LOG_GROUP_START(crtp)
// LOG_ADD(LOG_UINT16, rxRate, &stats.rxRate)
// LOG_ADD(LOG_UINT16, txRate, &stats.txRate)
// LOG_GROUP_STOP(crtp)
```

## src/crtp_commander.c
```c
/**
 *    ||          ____  _ __
 * +------+      / __ )(_) /_______________ _____  ___
 * | 0xBC |     / __  / / __/ ___/ ___/ __ `/_  / / _ \
 * +------+    / /_/ / / /_/ /__/ /  / /_/ / / /_/  __/
 *  ||  ||    /_____/_/\__/\___/_/   \__,_/ /___/\___/
 *
 * Crazyflie Firmware
 *
 * Copyright (C) 2011-2017 Bitcraze AB
 *
 * This program is free software: you can redistribute it and/or modify
 * it under the terms of the GNU General Public License as published by
 * the Free Software Foundation, in version 3.
 *
 * This program is distributed in the hope that it will be useful,
 * but WITHOUT ANY WARRANTY; without even the implied warranty of
 * MERCHANTABILITY or FITNESS FOR A PARTICULAR PURPOSE. See the
 * GNU General Public License for more details.
 *
 * You should have received a copy of the GNU General Public License
 * along with this program. If not, see <http://www.gnu.org/licenses/>.
 *
 *crtp_commander.c
 */
#include <stdbool.h>
#include <stddef.h>

#include <zephyr\sys\__assert.h>

#include "crtp_commander.h"

#include "cfassert.h"
#include "commander.h"
#include "crtp.h"


static bool isInit;

static void commanderCrtpCB(CRTPPacket* pk);

void crtpCommanderInit(void)
{
  if(isInit) {
    return;
  }

  crtpInit();
  crtpRegisterPortCB(CRTP_PORT_SETPOINT, commanderCrtpCB);
  crtpRegisterPortCB(CRTP_PORT_SETPOINT_GENERIC, commanderCrtpCB);
  isInit = true;
}

enum crtpSetpointGenericChannel {
  SET_SETPOINT_CHANNEL = 0,
  META_COMMAND_CHANNEL = 1,
};

/* Channel 1 of the generic commander port is used for "meta-commands"
 * that alter the behavior of the commander itself, e.g. mode switching.
 * Although we use the generic commander port due to increasing pressure on the
 * 4-bit space of ports numbers, meta-commands that are unrelated to
 * streaming generic setpoint control modes are permitted.
 *
 * The packet format for meta-commands is:
 * +------+==========================+
 * | TYPE |     DATA                 |
 * +------+==========================+
 *
 * TYPE is an 8-bit value. The remainder of the data depends on the command.
 * The maximum data size is 29 bytes.
 */

/* To add a new packet:
 *   1 - Add a new type in the metaCommand_e enum.
 *   2 - Implement a decoder function with good documentation about the data
 *       structure and the intent of the packet.
 *   3 - Add the decoder function to the metaCommandDecoders array.
 *   4 - Create a new params group for your handler if necessary
 *   5 - Pull-request your change :-)
 */

/* ---===== 1 - metaCommand_e enum =====--- */
enum metaCommand_e {
  metaNotifySetpointsStop = 0,
  nMetaCommands,
};

typedef void (*metaCommandDecoder_t)(const void *data, size_t datalen);

/* ---===== 2 - Decoding functions =====--- */

/* notifySetpointsStop meta-command. See commander.h function
 * commanderNotifySetpointsStop() for description and motivation.
 */
struct notifySetpointsStopPacket {
  uint32_t remainValidMillisecs;
} __attribute__((packed));
void notifySetpointsStopDecoder(const void *data, size_t datalen)
{
  __ASSERT(datalen == sizeof(struct notifySetpointsStopPacket),"crtp_commander datalen");
  // Note: The remainValidMillisecs argument is an artifact of the old
  // pull-based high-level commander architecture, and is no longer needed.
  commanderRelaxPriority();
}

 /* ---===== packetDecoders array =====--- */
const static metaCommandDecoder_t metaCommandDecoders[] = {
  [metaNotifySetpointsStop] = notifySetpointsStopDecoder,
};

/* Decoder switch */
static void commanderCrtpCB(CRTPPacket* pk)
{
  static setpoint_t setpoint;

  if(pk->port == CRTP_PORT_SETPOINT && pk->channel == 0) {
    crtpCommanderRpytDecodeSetpoint(&setpoint, pk);
    commanderSetSetpoint(&setpoint, COMMANDER_PRIORITY_CRTP);
  } else if (pk->port == CRTP_PORT_SETPOINT_GENERIC) {
    switch (pk->channel) {
    case SET_SETPOINT_CHANNEL:
      crtpCommanderGenericDecodeSetpoint(&setpoint, pk);
      commanderSetSetpoint(&setpoint, COMMANDER_PRIORITY_CRTP);
      break;
    case META_COMMAND_CHANNEL: {
        uint8_t metaCmd = pk->data[0];
        if (metaCmd < nMetaCommands && (metaCommandDecoders[metaCmd] != NULL)) {
          metaCommandDecoders[metaCmd](pk->data + 1, pk->size - 1);
        }
      }
      break;
    default:
      /* Do nothing */
      break;
    }
  }
}
```

## src/crtpservice.c
```c
/**
 * crtpservice.c - Implements low level services for CRTP
 */

#include <stdbool.h>
#include <string.h>
#include <strings.h>

/* FreeRtos includes */
#include <zephyr/kernel.h>

#include "crtp.h"
#include "crtpservice.h"
#include "param.h"
#include "config.h"


typedef enum {
  linkEcho   = 0x00,
  linkSource = 0x01,
  linkSink   = 0x02,
} LinkNbr;


static bool isInit=false;
static uint16_t echoDelay=0;

K_THREAD_STACK_DEFINE(crtpSrvTaskStack, CRTP_SRV_TASK_STACKSIZE);
struct k_thread crtpSrvTask;

static void crtpSrvTaskFunc(void*);

void crtpserviceInit(void)
{
  if (isInit)
    return;

  //Start the task
  k_tid_t my_tid = k_thread_create(&crtpSrvTask, crtpSrvTaskStack,
                                 K_THREAD_STACK_SIZEOF(crtpSrvTaskStack),
                                 crtpSrvTaskFunc,
                                 NULL, NULL, NULL,
                                 CRTP_SRV_TASK_PRI, 0, K_NO_WAIT);

  isInit = true;
}

bool crtpserviceTest(void)
{
  return isInit;
}

static void crtpSrvTaskFunc(void* prm)
{
  static CRTPPacket p;

  crtpInitTaskQueue(CRTP_PORT_LINK);

  while(1) {
    crtpReceivePacketBlock(CRTP_PORT_LINK, &p);

    switch (p.channel)
    {
      case linkEcho:
        if (echoDelay > 0) {
          K_TICKS(k_ms_to_ticks_ceil32(echoDelay));
        }
        crtpSendPacketBlock(&p);
        break;
      case linkSource:
        p.size = CRTP_MAX_DATA_SIZE;
        bzero(p.data, CRTP_MAX_DATA_SIZE);
        strcpy((char*)p.data, "Bitcraze Crazyflie");
        crtpSendPacketBlock(&p);
        break;
      case linkSink:
        /* Ignore packet */
        break;
      default:
        break;
    }
  }
}

// PARAM_GROUP_START(crtpsrv)
// PARAM_ADD(PARAM_UINT16, echoDelay, &echoDelay)
// PARAM_GROUP_STOP(crtpsrv)
```

## src/eeprom.c
```c
/**
 *    ||          ____  _ __
 * +------+      / __ )(_) /_______________ _____  ___
 * | 0xBC |     / __  / / __/ ___/ ___/ __ `/_  / / _ \
 * +------+    / /_/ / / /_/ /__/ /  / /_/ / / /_/  __/
 *  ||  ||    /_____/_/\__/\___/_/   \__,_/ /___/\___/
 *
 * Crazyflie Firmware
 *
 * Copyright (C) 2011 Fabio Varesano <fvaresano@yahoo.it>
 * Copyright (C) 2011-2020 Bitcraze AB
 *
 * This program is free software: you can redistribute it and/or modify
 * it under the terms of the GNU General Public License as published by
 * the Free Software Foundation, in version 3.
 *
 * This program is distributed in the hope that it will be useful,
 * but WITHOUT ANY WARRANTY; without even the implied warranty of
 * MERCHANTABILITY or FITNESS FOR A PARTICULAR PURPOSE. See the
 * GNU General Public License for more details.
 *
 * You should have received a copy of the GNU General Public License
 * along with this program. If not, see <http://www.gnu.org/licenses/>.
 *
 * @file eeprom.c
 * Driver for the 24AA64F eeprom.
 *
 */
#define DEBUG_MODULE "EEPROM"

#include <string.h>

#include <zephyr\device.h>
#include <zephyr\kernel.h>
#include <zephyr\kernel\thread.h>
#include <zephyr\logging\log.h>

#include "eeprom.h"
// #include "debug.h"
#include "mem.h"

LOG_MODULE_REGISTER(eeprom, LOG_LEVEL_DBG);

#ifdef EEPROM_RUN_WRITE_READ_TEST
static bool eepromTestWriteRead(void);
#endif

static uint32_t handleMemGetSize(void) { return EEPROM_SIZE; }
static bool handleMemRead(const uint32_t memAddr, const uint8_t readLen, uint8_t* buffer);
static bool handleMemWrite(const uint32_t memAddr, const uint8_t writeLen, const uint8_t* buffer);
static const MemoryHandlerDef_t memDef = {
  .type = MEM_TYPE_EEPROM,
  .getSize = handleMemGetSize,
  .read = handleMemRead,
  .write = handleMemWrite,
};

static uint8_t devAddr;
const struct device *I2Cx;
static bool isInit;

bool eepromInit(const struct device *i2cPort)
{
  if (isInit) {
    return true;
  }

  memoryRegisterHandler(&memDef);

  I2Cx = i2cPort;
  devAddr = EEPROM_I2C_ADDR;

  isInit = true;

  return true;
}

bool eepromTest(void)
{
  bool status;

  status = eepromTestConnection();
  if (status)
  {
    LOG_INF("I2C connection [OK].\n");
  }
  else
  {
    LOG_INF("I2C connection [FAIL].\n");
  }

#ifdef EEPROM_RUN_WRITE_READ_TEST
  status = eepromTestWriteRead();
#endif

  return status;
}

#ifdef EEPROM_RUN_WRITE_READ_TEST
static bool eepromTestWriteRead(void)
{
  bool status = true;
  int i;
  const uint8_t testData[20] = {0,1,2,3,4,5,6,7,8,9,10,11,12,13,14,15,16,17,18,19};
  uint8_t readData[20];

  for (i = 0; i < sizeof(testData) && status; i++)
  {
    // Write one byte with increasing addresses.
    eepromWriteBuffer(&testData[i], i, 1);
    // Read it all back and check
    eepromReadBuffer(readData, 0, i+1);
    status = (memcmp(testData, readData, i+1) == 0);
  }

  // Write it all.
  eepromWriteBuffer(testData, 0, sizeof(testData));
  for (i = 0; i < sizeof(testData) && status; i++)
  {
    // Read one byte with increasing addresses and check
    eepromReadBuffer(&readData[i], i, 1);
    status = (memcmp(testData, readData, i+1) == 0);
  }

  return status;
}
#endif

bool eepromTestConnection(void)
{
  uint8_t tmp;
  bool status;

  if (!isInit)
    return false;

  status = i2cdevRead16(I2Cx, devAddr, 0, 1, &tmp);

  return status;
}

bool eepromReadBuffer(uint8_t* buffer, uint16_t readAddr, uint16_t len)
{
  bool status;

  if ((uint32_t)readAddr + len > EEPROM_SIZE)
  {
     return false;
  }

  status = i2cdevRead16(I2Cx, devAddr, readAddr, len, buffer);

  return status;
}

bool eepromWriteBuffer(const uint8_t* buffer, uint16_t writeAddr, uint16_t len)
{
  bool status;

  unsigned char pageBuffer[32];
  int bufferIndex = 0;
  int leftToWrite = len;
  uint16_t currentAddress = writeAddr;
  uint16_t pageAddress = writeAddr;

  if ((uint32_t)writeAddr + len > EEPROM_SIZE)
  {
     return false;
  }

  while (leftToWrite > 0) {
    int pageIndex = 0;
    pageAddress = currentAddress;
    do {
      pageBuffer[pageIndex++] = buffer[bufferIndex++];
      leftToWrite -= 1;
      currentAddress += 1;
    } while ((leftToWrite > 0) && (currentAddress % 32 != 0));

    // Writing page
    for (int retry = 0; retry < 10; retry++) {
      status = i2cdevWrite16(I2Cx, devAddr, pageAddress, pageIndex, pageBuffer);
      if (status) {
        break;
      }
      K_MSEC(6);
    }
    if (!status) {
      return false;
    }

    // Waiting for page to be written
    for (int retry = 0; retry < 30; retry++) {
      uint8_t dummy;
      status = i2cdevWrite(I2Cx, devAddr, 1, &dummy);

      if (status) {
        break;
      }

      K_MSEC(1);
    }
    if (!status) {
      return false;
    }
  }

  return status;
}

bool eepromWritePage(uint8_t* buffer, uint16_t writeAddr)
{
 //TODO: implement
  return false;
}

static bool handleMemRead(const uint32_t memAddr, const uint8_t readLen, uint8_t* buffer) {
  bool result = false;

  if (memAddr + readLen <= EEPROM_SIZE) {
    if (eepromReadBuffer(buffer, memAddr, readLen)) {
      result = true;
    }
  }

  return result;
}

static bool handleMemWrite(const uint32_t memAddr, const uint8_t writeLen, const uint8_t* buffer) {
  bool result = false;

  if (memAddr + writeLen <= EEPROM_SIZE) {
    if (eepromWriteBuffer(buffer, memAddr, writeLen)) {
      result = true;
    }
  }

  return result;
}
```
